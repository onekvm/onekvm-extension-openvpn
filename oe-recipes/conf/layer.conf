## oe-recipes/conf/layer.conf
```bitbake
BBPATH .= ":${LAYERDIR}"
BBFILES += "${LAYERDIR}/recipes-*/*/*.bb ${LAYERDIR}/recipes-*/*/*.bbappend"
BBFILE_COLLECTIONS += "onekvm-extension-openvpn"
BBFILE_PATTERN_onekvm-extension-openvpn := "^${LAYERDIR}/"
BBFILE_PRIORITY_onekvm-extension-openvpn = "8"
LAYERDEPENDS_onekvm-extension-openvpn = "core onekvm"
LAYERSERIES_COMPAT_onekvm-extension-openvpn = "wrynose"
```
